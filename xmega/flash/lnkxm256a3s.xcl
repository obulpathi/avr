/*                      - lnkxm256a3s.xcl -
 *
 *   XLINK command file for the ICCAVR C-compiler using the --cpu=xm256a3, -ms
 *   options. Segments are defined for an ATxmega256A3 whithout external
 *   memory. It is also possible to "add" external SRAM, EPROM and EEPROM.
 *
 *   Usage: xlink your_file(s) -f lnkxm256a3s
 *
 *   File version: $Revision: 6935 $
 */

/*====================================================*/
/* 
 * Constants used down below, 
 * Do not change these lines, 
 * if it is not stated otherwise 
 */

/* Code (flash) segments */
-D_..X_INTVEC_SIZE=1E8   /* 4 bytes * 122 vectors */
-D_..X_FLASH_NEND=FFFF   /* End of near flash memory */

-D_..X_APPLICATION_SIZE=40000
-D_..X_BOOT_SIZE=2000
-D_..X_APPLICATION_TABLE_SIZE=2000

-D_..X_FLASH_END=(_..X_APPLICATION_SIZE+_..X_BOOT_SIZE-1)
-D_..X_APPLICATION_START=_..X_INTVEC_SIZE
-D_..X_APPLICATION_END=(_..X_FLASH_END-_..X_BOOT_SIZE-_..X_APPLICATION_TABLE_SIZE)
-D_..X_APPLICATION_TABLE_START=(_..X_APPLICATION_END+1)
-D_..X_APPLICATION_TABLE_END=(_..X_FLASH_END-_..X_BOOT_SIZE)
-D_..X_BOOT_START=(_..X_APPLICATION_TABLE_END+1)
-D_..X_BOOT_END=_..X_FLASH_END

/* Internal data memory */

-D_..X_SRAM_BASE=2000   /* Start of ram memory */
-D_..X_SRAM_END=5FFF    /* End of ram memory */

/* Internal EEPROM */
-D_..X_EEPROM_END=FFF   /* End of eeprom memory */
-D_..X_EEPROM_START=0
/*====================================================*/


/*
 * Modify the lines below to alter the size of the RSTACK, CSTACK and HEAP
 * segments. These need to be fine tuned to suit your specific application.
 * The '_..X_' prefix is used by C-SPY as an indication that the label should
 * not be displayed in the dissassembly window.
 */
-D_..X_CSTACK_SIZE=200  /* 512 bytes for auto variables and saved registers. */
-D_..X_RSTACK_SIZE=40   /* 64 bytes for return addresses, equivalent to 32 */
                        /* levels of calls, including interrupts. */

-D_..X_HEAP_SIZE=100         /* 256 bytes of heap. */
-D_..X_NEAR_HEAP_SIZE=100    /* 256 bytes of heap. */
-D_..X_FAR_HEAP_SIZE=100     /* 256 bytes of heap. */
-D_..X_HUGE_HEAP_SIZE=100    /* 256 bytes of heap. */

/*
 * Modify these lines if you have an external SRAM connected to the system.
 *
 * Note: Remember to turn on the external data and address busses in
 *       __low_level_init if external memory is used.
 */
-D_..X_EXT_SRAM_BASE=_..X_SRAM_BASE
-D_..X_EXT_SRAM_SIZE=0

/*
 * Modify these lines if you have an external EPROM connected to the system.
 *
 * Note: Remember to turn on the external data and address busses in
 *       __low_level_init if external memory is used.
 */
-D_..X_EXT_EPROM_BASE=_..X_SRAM_BASE
-D_..X_EXT_EPROM_SIZE=0

/*
 * Modify these lines if you have an external EEPROM connected to the system.
 *
 * Note: Remember to turn on the external data and address busses in
 *       __low_level_init if external memory is used.
 */
-D_..X_EXT_EEPROM_BASE=_..X_SRAM_BASE
-D_..X_EXT_EEPROM_SIZE=0


/*
 * The following segments are located in the internal memory of
 * the ATxmega256A3. Do not change these lines.
 */

/* Define CPU */
-ca90

/* Code memory */
-Z(CODE)INTVEC=_..X_BOOT_START-(_..X_BOOT_START+_..X_INTVEC_SIZE-1) 
//-Z(CODE)INTVEC=0-(_..X_INTVEC_SIZE-1)

/* Fill unused interrupt vector's with RETI */
-H1895
-h(CODE)_..X_BOOT_START-(_..X_BOOT_START+_..X_INTVEC_SIZE)
//-h(CODE)0-(_..X_INTVEC_SIZE)

//-D_..X_FLASH_BASE=_..X_INTVEC_SIZE
-D_..X_FLASH_BASE=(_..X_INTVEC_SIZE+_..X_BOOT_START)

-Z(CODE)NEAR_F=_..X_FLASH_BASE-(_..X_FLASH_BASE+FFFF)
-Z(CODE)SWITCH=_..X_FLASH_BASE-(_..X_FLASH_BASE+FFFF)
-Z(CODE)DIFUNCT=_..X_FLASH_BASE-(_..X_FLASH_BASE+FFFF)
-Z(CODE)FAR_ID=10000-_..X_FLASH_END
-Z(CODE)CODE=_..X_FLASH_BASE-_..X_BOOT_END
-Z(CODE)FARCODE=_..X_FLASH_BASE-_..X_FLASH_END
-Z(CODE)FAR_F=[_..X_FLASH_BASE-_..X_FLASH_END]/10000
-Z(CODE)INITTAB=_..X_FLASH_BASE-_..X_FLASH_END
-Z(CODE)HUGE_F=_..X_FLASH_BASE-_..X_FLASH_END
-Z(CODE)TINY_ID=_..X_FLASH_BASE-_..X_FLASH_END
-Z(CODE)NEAR_ID=_..X_FLASH_BASE-_..X_FLASH_END
-Z(CODE)HUGE_ID=_..X_FLASH_BASE-_..X_FLASH_END

-Z(CODE)APPLICATION=_..X_INTVEC_SIZE-_..X_APPLICATION_END
-Z(CODE)APPLICATION_TABLE=_..X_APPLICATION_TABLE_START-_..X_APPLICATION_TABLE_END
-Z(CODE)BOOT=(_..X_BOOT_START+_..X_INTVEC_SIZE+1)-_..X_BOOT_END

-Z(CODE)CHECKSUM#_..X_FLASH_END

/* Internal data memory */
-Z(DATA)NEAR_I,NEAR_Z=_..X_SRAM_BASE-_..X_SRAM_END

-Z(DATA)RSTACK+_..X_RSTACK_SIZE=_..X_SRAM_BASE-_..X_SRAM_END
-Z(DATA)CSTACK+_..X_CSTACK_SIZE=_..X_SRAM_BASE-_..X_SRAM_END

-Z(DATA)HEAP+_..X_HEAP_SIZE=_..X_SRAM_BASE-_..X_SRAM_END
-Z(DATA)IOSTREAM_N#_..X_SRAM_BASE-_..X_SRAM_END
-Z(DATA)NEAR_HEAP+_..X_NEAR_HEAP_SIZE=_..X_SRAM_BASE-_..X_SRAM_END

/* Internal eeprom memory */
-Z(XDATA)EEPROM_I,EEPROM_N=_..X_EEPROM_START-_..X_EEPROM_END

/*
 * The following segment definitions are only used if external memory is
 * connected to the AVR controller.
 */

/* External EPROM */
-Z(CONST)NEAR_C=_..X_EXT_EPROM_BASE:+_..X_EXT_EPROM_SIZE

/* External EEPROM */
-Z(DATA)NEAR_N=_..X_EXT_EEPROM_BASE:+_..X_EXT_EEPROM_SIZE

/* The __far and __huge segments */

/* 
 * FAR_I must have the same offset
 * from a 64 Kbyte boundary as FAR_ID 
 */
-Z(DATA)FAR_I=[10000-FFFFFF]/10000

-Z(DATA)FAR_Z,FAR_N,FAR_C=[_..X_SRAM_BASE-FFFFFF]/10000
-Z(DATA)FAR_HEAP+_..X_FAR_HEAP_SIZE=_..X_SRAM_BASE-FFFFFF
-Z(DATA)HUGE_I,HUGE_Z,HUGE_N,HUGE_C=_..X_SRAM_BASE-FFFFFF
-Z(DATA)HUGE_HEAP+_..X_HUGE_HEAP_SIZE=_..X_SRAM_BASE-FFFFFF

/* Select reduced "printf" support to reduce library size.
   See configuration section in manual concerning printf/sprintf. */

/*Dlib*/
-e_PrintfSmall=_Printf

/*Clib*/
-e_small_write=_formatted_write

/*Dlib and Clib*/
-e_small_write_P=_formatted_write_P

/* Disable floating-point support in "scanf" to reduce library size.
   See configuration section in manual concerning scanf/sscanf */

/*Dlib*/
-e_ScanfSmall=_Scanf

/*Clib*/
-e_medium_read=_formatted_read

/*Dlib and Clib*/
-e_medium_read_P=_formatted_read_P

/* Suppress one warning which is not relevant for this processor */
-w29

/* Code will now reside in file aout.a90 or aout.d90, unless -o is specified */
/* .d90 is the default if debug system is linked (option -r) */
/* .a90 is the default without debugging. Default format is -Fmotorola */
